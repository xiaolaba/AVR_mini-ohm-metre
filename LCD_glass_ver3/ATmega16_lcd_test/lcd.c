// original copy : https://www.amobbs.com/forum.php?mod=viewthread&tid=4560171
/*
 * original file saved as GBK, converts to UTF8 CHT
 * tools: https://github.com/flier268/ConvertZZ
 * xiaolaba, 2020-AUG-18
 * 
 * port to avr-gcc, u8 -> uint8_t, u16 -> uint16_t
 * port to ATmeag8, oroginal ATmega16
 * 
 */
 
 



/******************** (C) COPYRIGHT 2011 bluefeel ********************
* File Name          : lcd.c
* Author             : bluefeel
* Date First Issued  : 2011.2.12
* Description        : 定義段式液晶編碼轉換的函式
********************************************************************************
* 程式歷史:
* 2011.1.30 : Version 1.0
* 2011.2.12 : Version 2.0（ATmega16）
********************************************************************************
* 目前程式意在為程式設計師提供段式液晶編碼指導，以便程式設計師為他們的產品節省時間。
* 因此，對於使用該程式或編碼資訊的個人與團體而造成相關產品的任何直接、間接的
* 損失，本人將不承擔任何方面的責任，亦不道歉。本人亦有且只按個人意願提供有限
* 的技術支援。
*******************************************************************************/

/*------------------------------------------------------------------------------
段式液晶真值表:

             ___________________________________________________________
            |   _A_   |   _A_   |   _A_   |   _A_   |   _A_   |   _A_   |
            | F|   |B | F|   |B | F|   |B | F|   |B | F|   |B | F|   |B |
            |  |_G_|  |  |_G_|  |  |_G_|  |  |_G_|  |  |_G_|  |  |_G_|  |
            | E|   |C | E|   |C | E|   |C | E|   |C | E|   |C | E|   |C |
            |  |___|  |  |___|  |  |___|  | .|___|  | .|___|  | .|___|  |
            |    D    |    D    |    D    | P  D    | P  D    | P  D    |
            |_________|_________|_________|_________|_________|_________|
             PD0..PD1..PD2..PD3.................PD7..PC0.............PC3
     --------------------------------------------------------------------
     |      | S0 | S1 | S2 | S3 | S4 | S5 | S6 | S7 | S8 | S9 | S10| S11|
     --------------------------------------------------------------------
PA0  | COM0 | 0D |    | 1D |    | 2D |    | 3D | 3P | 4D | 4P | 5D | 5P |
     --------------------------------------------------------------------
PA1  | COM1 | 0E | 0C | 1E | 1C | 2E | 2C | 3E | 3C | 4E | 4C | 5E | 5C |
     --------------------------------------------------------------------
PA2  | COM2 | 0G | 0B | 1G | 1B | 2G | 2B | 3G | 3B | 4G | 4B | 5G | 5B |
     --------------------------------------------------------------------
PA3  | COM3 | 0F | 0A | 1F | 1A | 2F | 2A | 3F | 3A | 4F | 4A | 5F | 5A |
     --------------------------------------------------------------------
            |    0    |    1    |    2    |    3    |    4    |    5    |

一個LCD字元根據以下矩陣編碼：
 { D ,   }
 { E , C }
 { G , B }
 { F , A }
例如字元2：
 { 1 , 0 }
 { 1 , 0 }
 { 1 , 1 }
 { 0 , 1 }

=  7   C
=> '2' = 0xC7

IO輸出高低電平時候COMx為對應電平，IO高阻輸入時COMx為電阻分壓，即VDD/2

               VDD
                |
                -
               | |
               | |      1M or other value
               | |
                -
                |
 IO ------------+------------ to LCD COMx
                |
                -
               | |
               | |      1M or other value
               | |
                -
                |
               GND

COMx有效時候IO輸出低電平或者高電平
COMx為低電平時在字元0處顯示'2'的真值表：
------------------
|      |SEG0|SEG1|
------------------
| COM0 | 1  | 0  |
------------------
| COM1 | 1  | 0  |
------------------
| COM2 | 1  | 1  |
------------------
| COM3 | 0  | 1  |
------------------
         7    C
COMx為高電平時在字元0處顯示'2'的真值表：
------------------
|      |SEG0|SEG1|
------------------
| COM0 | 0  | 1  |
------------------
| COM1 | 0  | 1  |
------------------
| COM2 | 0  | 0  |
------------------
| COM3 | 1  | 0  |
------------------
        ~7   ~C

字元0處顯示'2'的時序圖：

        0 1  2 3  4 5  6 7  8 9  A B  C D  E F  0 1  2 3
       |COM0有效 |COM1有效 |COM2有效 |COM3有效 |COM0有效 |
             _                                       _
COM0        | |   _    _    _    _    _    _        | |
       _____| |__| |__| |__| |__| |__| |__| |_______| |__
                       _
COM1    _    _        | |   _    _    _    _    _    _
       | |__| |_______| |__| |__| |__| |__| |__| |__| |__
                                 _
COM2    _    _    _    _        | |   _    _    _    _
       | |__| |__| |__| |_______| |__| |__| |__| |__| |__
                                           _
COM3    _    _    _    _    _    _        | |   _    _
       | |__| |__| |__| |__| |__| |_______| |__| |__| |__
        _         _         _              _    _
SEG0   | |       | |       | |            | |  | |
       | |_______| |_______| |____________| |__| |_______
             _         _    _         _              _
SEG1        | |       | |  | |       | |            | |
       _____| |_______| |__| |_______| |____________| |__

圖中如0和1、2和3位置代表兩個波形週期。0或2為前半週期，COMx為高低電平，SEGx和COMx
之間的電平為VDD、-VDD時候對應的段顯示，電平為0或VDD/2、-VDD/2時不顯示。1或3為後半
週期，所有COM和SEG都為低電平，所有的段滅。目前半週期等於後半週期時候，就是1/2占空
比，調節占空比可以調節對比度。
------------------------------------------------------------------------------*/

#include <avr/io.h>
#include <stdint.h>
//#include <avr/interrupt.h>

#include "lcd.h"

// LCD幀快取
uint16_t frame[4];

// 數字'0'~'9'
const uint8_t number[16] = {0xEB, 0x60, 0xC7, 0xE5, 0x6C, 0xAD, 0xAF, 0xE0, 0xEF, 0xED, 0xEE, 0x2F, 0x8B, 0x67, 0x8F, 0x8E};

/*------------------------------------------------------------------------------
函式名：void LCD_Write_Str(u8 *str)
------------------------------------------------------------------------------*/
void LCD_Write_Str(uint8_t *str)
{
	uint8_t i, Show_Char;
    
    Show_Char=0; //init, remove warning

	frame[0] = 0;
	frame[1] = 0;
	frame[2] = 0;
	frame[3] = 0;

	for (i=0; i<6; i++)
	{
		// 查詢碼段儲存在Show_Char
		if((*(str + i) < 0x3A) && (*(str + i) > 0x2F))       // 數字'0'~'9'
			Show_Char = number[*(str + i) - 0x30];
		else if((*(str + i) < 0x47) && (*(str + i) > 0x40))  // 字母'A'~'F'
			Show_Char = number[*(str + i) - 55];
		else if((*(str + i) < 0x67) && (*(str + i) > 0x60))  // 字母'a'~'f'
			Show_Char = number[*(str + i) - 87];

		if(Show_Char & 0x01) frame[0] |= 0x0001 << (i << 1);
		if(Show_Char & 0x10) frame[0] |= 0x0002 << (i << 1);
		if(Show_Char & 0x02) frame[1] |= 0x0001 << (i << 1);
		if(Show_Char & 0x20) frame[1] |= 0x0002 << (i << 1);
		if(Show_Char & 0x04) frame[2] |= 0x0001 << (i << 1);
		if(Show_Char & 0x40) frame[2] |= 0x0002 << (i << 1);
		if(Show_Char & 0x08) frame[3] |= 0x0001 << (i << 1);
		if(Show_Char & 0x80) frame[3] |= 0x0002 << (i << 1);
	}
}
